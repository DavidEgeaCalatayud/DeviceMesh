## firmware/esp32/main/Kconfig.projbuild
```kconfig
menu "DeviceMesh hardware"

config DM_BME280_ENABLED
    bool "Enable BME280 environmental sensor"
    default n
    help
        Enable temperature, humidity and pressure acquisition from a BME280 over I2C.

config DM_BME280_SDA_GPIO
    int "BME280 SDA GPIO"
    depends on DM_BME280_ENABLED
    default 21
    range 0 48

config DM_BME280_SCL_GPIO
    int "BME280 SCL GPIO"
    depends on DM_BME280_ENABLED
    default 22
    range 0 48

config DM_REQUIRE_HARDENING
    bool "Require Secure Boot and flash encryption at runtime"
    default n
    help
        Enable for production/manufacturing builds after provisioning the
        corresponding eFuses and signing/encryption keys. Firmware fails
        closed before reading DeviceMesh credentials if either protection
        is unavailable.

config DM_RECOVERY_GPIO
    int "Recovery button GPIO"
    default 27
    range 0 48
    help
        Hold this active-low GPIO for three seconds during boot to clear Wi-Fi,
        DeviceMesh credentials and the offline queue while retaining device identity.

endmenu
```

## firmware/esp32/sdkconfig.defaults
```kconfig
CONFIG_BT_ENABLED=y
CONFIG_BT_NIMBLE_ENABLED=y
CONFIG_BT_CONTROLLER_ENABLED=y
CONFIG_ESP_MAIN_TASK_STACK_SIZE=8192
CONFIG_ESP_TASK_WDT_EN=y
CONFIG_ESP_TASK_WDT_INIT=y
CONFIG_ESP_TASK_WDT_TIMEOUT_S=60
CONFIG_MBEDTLS_CERTIFICATE_BUNDLE=y
CONFIG_MBEDTLS_DEFAULT_CERTIFICATE_BUNDLE=y

CONFIG_BOOTLOADER_APP_ROLLBACK_ENABLE=y
CONFIG_PARTITION_TABLE_CUSTOM=y
CONFIG_PARTITION_TABLE_CUSTOM_FILENAME="partitions.csv"
CONFIG_ESPTOOLPY_FLASHSIZE_4MB=y
```
